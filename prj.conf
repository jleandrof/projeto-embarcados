## CMakeLists.txt
```
# SPDX-License-Identifier: Apache-2.0

cmake_minimum_required(VERSION 3.20.0)

find_package(Zephyr REQUIRED HINTS $ENV{ZEPHYR_BASE})
project(projeto_embarcados)

target_sources(app PRIVATE src/main.c)
```

## prj.conf
```kconfig
# Habilitar BLE
# CONFIG_BT=y
# CONFIG_BT_PERIPHERAL=y
# CONFIG_BT_DEVICE_NAME="Env_Analyzer"
# CONFIG_BT_MAX_CONN=1
# CONFIG_BT_GATT_CLIENT=y

# Habilitar UART (para Shell)
CONFIG_CONSOLE=y
CONFIG_UART_CONSOLE=y
CONFIG_SHELL=y
CONFIG_SHELL_BACKEND_SERIAL=y

# Multitarefa e Threads
CONFIG_MAIN_THREAD_PRIORITY=0

# Habilitar I2C para sensores
CONFIG_I2C=y

# Habilitar ADC (para som)
CONFIG_ADC=y
CONFIG_ADC_ASYNC=y

# Pilhas e memórias
CONFIG_HEAP_MEM_POOL_SIZE=4096
CONFIG_SYSTEM_WORKQUEUE_STACK_SIZE=2048

# Sensores e Console
CONFIG_STDOUT_CONSOLE=y
CONFIG_SENSOR=y
```

## src/main.c
```c
#include <zephyr/kernel.h>
#include <zephyr/device.h>
#include <zephyr/devicetree.h>
#include <zephyr/drivers/i2c.h>
#include <zephyr/drivers/adc.h>
#include <zephyr/bluetooth/bluetooth.h>
#include <zephyr/bluetooth/gatt.h>
#include <zephyr/shell/shell.h>
#include <zephyr/sys/printk.h>
#include <zephyr/logging/log.h>
#include <zephyr/drivers/sensor.h>

#include "shell.c"

LOG_MODULE_REGISTER(env_analyzer, LOG_LEVEL_INF);

// Definições para os sensores
#define I2C_NODE DT_NODELABEL(i2c0)
#define ADC_NODE DT_NODELABEL(adc0)

// Buffers para dados de sensores
struct sensor_value temp, press, humidity;

// Device pointers
const struct device *i2c_dev = DEVICE_DT_GET(I2C_NODE);
const struct device *bme680 = DEVICE_DT_GET_ANY(bosch_bme680);

// Threads
void sensor_thread(void *arg1, void *arg2, void *arg3);
// void ble_thread(void *arg1, void *arg2, void *arg3);

// Função de inicialização do BLE
void ble_init() {
    int err = bt_enable(NULL);
    if (err) {
        printk("Erro ao inicializar BLE: %d", err);
        return;
    }

    LOG_INF("BLE inicializado com sucesso");
}

// Função de inicialização dos sensores
void sensor_init() {
    if (!device_is_ready(i2c_dev)) {
        printk("I2C não está pronto");
        return;
    }

    LOG_INF("Sensores inicializados");
}

// Thread para leitura dos sensores
void sensor_thread(void *arg1, void *arg2, void *arg3) {
    while (1) {
        
        sensor_sample_fetch(bme680);
		sensor_channel_get(bme680, SENSOR_CHAN_AMBIENT_TEMP, &temp);
		sensor_channel_get(bme680, SENSOR_CHAN_PRESS, &press);
		sensor_channel_get(bme680, SENSOR_CHAN_HUMIDITY, &humidity);

        if(sensor_pulling){
            printk("\nT: %d.%06d; P: %d.%06d; H: %d.%06d;\n",
				temp.val1, temp.val2, press.val1, press.val2,
				humidity.val1, humidity.val2);
        }
		

        k_sleep(K_SECONDS(5));
    }
}

// Thread para envio BLE
void ble_thread(void *arg1, void *arg2, void *arg3) {
    while (1) {
        // Atualizar valores no GATT
        // printk("Enviando dados BLE...");
        k_sleep(K_SECONDS(10));
    }
}

K_THREAD_DEFINE(sensor_tid, 2048, sensor_thread, NULL, NULL, NULL, 5, 0, 0);
K_THREAD_DEFINE(ble_tid, 2048, ble_thread, NULL, NULL, NULL, 5, 0, 0);

void main(void) {
    printk("Inicializando sistema...");
    // ble_init();
    sensor_init();
    printk("Sistema inicializado");
}
```

## src/shell.c
```c
#include <zephyr/shell/shell.h>

int sensor_pulling = 0;

static int cmd_set_limit(const struct shell *shell, size_t argc, char **argv) {
    if (argc != 3) {
        shell_print(shell, "Uso: set_limit <sensor> <valor>");
        return -EINVAL;
    }
    shell_print(shell, "Limite ajustado para %s: %s", argv[1], argv[2]);
    return 0;
}

static int cmd_show_sensor_log(const struct shell *shell, size_t argc, char **argv) {
    if (argc != 1) {
        shell_print(shell, "Uso: set_limit <sensor> <valor>");
        return -EINVAL;
    }

    sensor_pulling = 1;

    shell_print(shell, "Showing sensor log");
    return 0;
}

static int cmd_hide_sensor_log(const struct shell *shell, size_t argc, char **argv) {
    if (argc != 1) {
        shell_print(shell, "Uso: set_limit <sensor> <valor>");
        return -EINVAL;
    }

    sensor_pulling = 0;

    shell_print(shell, "Sensor log hidden");
    return 0;
}

// SHELL_CMD_REGISTER(set_limit, NULL, "Ajustar limites de sensores", cmd_set_limit);
SHELL_CMD_REGISTER(show_sensor_log, NULL, "Exibe logs do sensor de ambiente", cmd_show_sensor_log);
SHELL_CMD_REGISTER(hide_sensor_log, NULL, "Esconde logs do sensor de ambiente", cmd_hide_sensor_log);
```
